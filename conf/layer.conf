## conf/layer.conf
```bitbake
# We have a conf and classes directory, add to BBPATH
BBPATH .= ":${LAYERDIR}"

# We have a packages directory, add to BBFILES
BBFILES += "${LAYERDIR}/recipes-*/*/*.bb"
BBFILES += "${LAYERDIR}/recipes-*/*/*.bbappend"

BBFILE_COLLECTIONS += "syzkaller-wrl"
BBFILE_PATTERN_syzkaller-wrl = "^${LAYERDIR}/"
BBFILE_PRIORITY_syzkaller-wrl = "5"

LAYERDEPENDS_syzkaller-wrl = "core"

LAYERSERIES_COMPAT_syzkaller-wrl = "kirkstone"
```
